## components/pca9685/Kconfig
```kconfig
menu "Mega Unicorn Gundam Configuration"

    config PCA9685_I2C_MASTER_SCL
        int "PCA9685 - SCL GPIO Num"
        default 6 if IDF_TARGET_ESP32C3
        default 19 if IDF_TARGET_ESP32 || IDF_TARGET_ESP32S2 || IDF_TARGET_ESP32S3
        help
            GPIO number for I2C Master clock line.

    config PCA9685_I2C_MASTER_SDA
        int "PCA9685 - SDA GPIO Num"
        default 5 if IDF_TARGET_ESP32C3
        default 18 if IDF_TARGET_ESP32 || IDF_TARGET_ESP32S2 || IDF_TARGET_ESP32S3
        help
            GPIO number for I2C Master data line.

endmenu
```
